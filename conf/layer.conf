## conf/layer.conf
```bitbake
# We have a conf and classes directory, add to BBPATH
BBPATH .= ":${LAYERDIR}"

# We have recipes-* directories, add to BBFILES
BBFILES += "${LAYERDIR}/recipes-*/*/*.bb \
            ${LAYERDIR}/recipes-*/*/*.bbappend"

BBFILE_COLLECTIONS += "meta-auto-resize-partition"
BBFILE_PATTERN_meta-auto-resize-partition = "^${LAYERDIR}/"
BBFILE_PRIORITY_meta-auto-resize-partition = "6"

LAYERDEPENDS_meta-auto-resize-partition = "core"
LAYERSERIES_COMPAT_meta-auto-resize-partition = "warrior"
```
